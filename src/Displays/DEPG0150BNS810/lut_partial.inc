/* 
    File: lut_partial.inc

        - Lookup table for E-ink display
            Model: DEPG0150BNS810
            Refresh: Partial

            Unmodified from Heltec source
            (Previously, customized by me. Now, reverted)
            https://github.com/HelTecAutomation/Wireless-Paper/blob/ac5e7004309d9384c098e494d613f77c882d1d3c/src/DEPG0150BxS810FxX_BW.h#L18
*/

0x00, 0x40, 0x00, 0x00, 0x00, 0x00, 0x00, 0x00, 0x00, 0x00, 0x00, 0x00, 
0x80, 0x80, 0x00, 0x00, 0x00, 0x00, 0x00, 0x00, 0x00, 0x00, 0x00, 0x00, 
0x40, 0x40, 0x00, 0x00, 0x00, 0x00, 0x00, 0x00, 0x00, 0x00, 0x00, 0x00, 
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0x22, 0x22, 0x22, 0x22, 0x22, 0x22, 0x00, 0x00, 0x00