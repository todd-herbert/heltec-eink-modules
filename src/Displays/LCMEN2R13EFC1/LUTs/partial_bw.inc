/* 
    File: 

        - Lookup table for E-ink display
            Model: LCMEN2R13EFC1
            Refresh: Partial

            Source: Modified from GxEPD2 LUT for GDEW0154M09, which uses similar IC
                    https://github.com/ZinggJM/GxEPD2/blob/master/src/epd/GxEPD2_154_M09.cpp
*/

0x01, 0x84, 0x84, 0x83, 0x01, 0x01, 0x01,   // Difficulty in pulling the black pixels to white without blinking - repeating or lengthening doesn't help
0x00, 0x00, 0x00, 0x00, 0x00, 0x00, 0x00,
0x00, 0x00, 0x00, 0x00, 0x00, 0x00, 0x00,
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0x00, 0x00, 0x00, 0x00, 0x00, 0x00, 0x00,